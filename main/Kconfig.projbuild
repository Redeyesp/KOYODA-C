## main/Kconfig.projbuild
```kconfig
menu "KOYODA Audio Streaming (legacy, unused)"

    comment "koyoda_audio_stream.c is no longer built; see KOYODA Xiaozhi Backend below"

config KOYODA_STREAM_HOST
    string "PCM receiver host/IP"
    default "192.168.1.36"

config KOYODA_STREAM_PORT
    int "PCM receiver TCP port"
    range 1 65535
    default 7777

endmenu

menu "KOYODA Xiaozhi Backend"

config KOYODA_OTA_URL
    string "OTA check-in URL"
    default "https://api.tenclass.net/xiaozhi/ota/"
    help
        HTTPS endpoint KOYODA POSTs a small device-info JSON to on every
        reconnect attempt. The response's "websocket" section tells
        KOYODA which server + token to open the audio channel with,
        matching xiaozhi-esp32's own OTA check-in.

        Point this at your own self-hosted xiaozhi-esp32-server (or a
        compatible test harness) rather than a public endpoint unless
        you know what you're doing.

config KOYODA_LANGUAGE
    string "Language code sent to the server"
    default "en-US"
    help
        Sent as the Accept-Language header and the "language" field of
        the check-in body, matching xiaozhi-esp32's Lang::CODE.
        Use "zh-CN" for Chinese xiaozhi servers.

config KOYODA_BOARD_NAME
    string "Board identifier sent to the server"
    default "koyoda-esp32s3-amoled-1.75"
    help
        Sent in the OTA check-in body as "board". Purely informational;
        change it if you want your server-side logs/dashboard to show a
        friendlier name for this KOYODA unit.

endmenu

menu "KOYODA Audio Self-Test"

config KOYODA_CODEC_SELFTEST
    bool "Run Opus codec self-test at boot"
    default n
    help
        Generates a 440 Hz tone, runs it through the full
        resample -> Opus encode -> Opus decode -> resample chain and
        reports PASS/FAIL with measured length, pitch and level to the
        serial log. Needs no Wi-Fi, no server and no microphone.

        Adds about a second to boot. Turn off for normal use.

config KOYODA_ECHO_TEST
    bool "Local echo test instead of network backend"
    default n
    help
        Replaces the whole network backend with a local loopback:
        speak, pause, and KOYODA replays your voice after a real
        Opus encode/decode round trip.

        Use this to confirm the microphone, resampling, codec and
        speaker all work before blaming the server. KOYODA will NOT
        connect to any backend while this is enabled.

endmenu

menu "KOYODA Display Memory"

config KOYODA_SMALL_DRAW_BUFFER
    bool "Use a small DMA-capable LVGL draw buffer"
    default y
    help
        The display adapter defaults to a full-screen draw buffer in
        PSRAM. PSRAM cannot do DMA, so every flush forces spi_master to
        allocate a temporary DMA buffer from internal RAM -- the same
        pool the Opus codec and TLS need. When it runs out the display
        fails with "Failed to allocate priv TX buffer" and the face
        freezes or tears.

        Enabling this replaces it with a small buffer already in
        DMA-capable internal RAM, so no temporary allocation is needed
        at all. Turn off only to compare against the stock behaviour.

config KOYODA_DRAW_BUFFER_LINES
    int "Draw buffer height in lines"
    depends on KOYODA_SMALL_DRAW_BUFFER
    range 8 120
    default 24
    help
        Buffer size is 466 * lines * 2 bytes. 24 lines costs about
        22 KB. More lines means fewer, larger flushes (slightly faster)
        but takes more internal RAM away from the codec.

endmenu

menu "KOYODA Microphone"

config KOYODA_MIC_ANALOG_GAIN_DB
    int "ES7210 analog input gain (dB)"
    range 0 37
    default 33
    help
        Gain applied inside the microphone codec, before the ADC. This is
        the best place to fix a quiet mic because it captures more real
        signal instead of amplifying quantisation noise.

        At the original 24 dB, normal speech peaked near 3% of full scale;
        speech recognition works best around 15-30%. 33 dB is a safe step
        up that leaves headroom; 37 is the chip maximum.

        Watch the "MIC ... peak=" line in the serial log while talking
        normally and tune so peaks land in the low thousands. If the noise
        floor (shown as "noise=") climbs above ~80, back this off.

config KOYODA_MIC_DIGITAL_GAIN_X10
    int "Extra digital gain for the AI stream (x10)"
    range 10 80
    default 20
    help
        Multiplier applied only to the audio sent to the server, in tenths:
        10 = 1.0x (off), 20 = 2.0x, 35 = 3.5x.

        This does NOT affect VAD, the local beep or playback, so it cannot
        change how the pet behaves offline. It adds no new information, so
        raise the analog gain above first and use this for the remainder.

        A warning is logged if it clips continuously.

endmenu

menu "KOYODA Voice Detection"

choice KOYODA_VAD_PRESET
    prompt "VAD sensitivity preset"
    default KOYODA_VAD_NORMAL
    help
        Controls when KOYODA decides you have started and stopped
        speaking. It does NOT change microphone gain: raising gain lifts
        speech and noise equally and was measured to make recognition
        worse, while these settings change how KOYODA judges speech
        relative to the room's own noise level.

        The noise floor already adapts automatically (about 20 at home,
        about 50 in an office), so the preset changes how aggressive that
        adaptation is, not a fixed level.

    config KOYODA_VAD_SENSITIVE
        bool "Sensitive - quiet room, soft or slow speech"
        help
            Lower threshold and waits 1200 ms of silence before ending an
            utterance, so a pause mid-sentence does not cut you off.
            May trigger on fans or air conditioning.

    config KOYODA_VAD_NORMAL
        bool "Normal - the tested default"
        help
            Exactly the values used in every build so far: 850 ms end
            silence, threshold = noise*3 + 30, floor 70. Choose this to
            keep current behaviour.

    config KOYODA_VAD_OUTDOOR
        bool "Outdoor - crowds, traffic, noisy cafe"
        help
            Much higher threshold so nearby conversation does not trigger
            KOYODA, and a shorter 700 ms end silence. You must speak
            deliberately toward the device.

endchoice

endmenu
```
